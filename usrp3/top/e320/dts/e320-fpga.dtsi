/*
 * Copyright (c) 2018 National Instruments Corp
 *
 * SPDX-License-Identifier: GPL-2.0 OR X11
 */

fragment@0 {
	target = <&fpga_full>;
	reg = <0x0000>;
	#address-cells = <1>;
	#size-cells = <1>;
	__overlay__ {
		#address-cells = <1>;
		#size-cells = <1>;
		firmware-name = "e320.bin";
	};
};
