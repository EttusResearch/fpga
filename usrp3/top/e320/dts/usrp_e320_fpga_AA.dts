/*
 * Copyright (c) 2018 National Instruments Corp
 *
 * SPDX-License-Identifier: GPL-2.0 OR X11
 */

/dts-v1/;
/plugin/;

/{

#include "e320-fpga.dtsi"

fragment@1 {
	target = <&amba>;
	reg = <0x0001>;
	__overlay__ {
		uio@40004000 {
			compatible = "usrp-uio";
			reg = <0x40004000 0x1000>; //FIXME
			reg-names = "misc-auro-regs";
			status = "okay";
		};
	};
};

#include "e320-common.dtsi"
#include "dma-common.dtsi"

};

