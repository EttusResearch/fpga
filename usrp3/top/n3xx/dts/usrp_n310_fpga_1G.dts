/*
 * Copyright (c) 2017 National Instruments Corp
 *
 * SPDX-License-Identifier: GPL-2.0 OR X11
 */

/dts-v1/;
/plugin/;

/{

fragment@0 {
	target = <&fpga_region0>;
	reg = <0x0000>;
	#address-cells = <1>;
	#size-cells = <1>;
	__overlay__ {
		#address-cells = <1>;
		#size-cells = <1>;
		firmware-name = "n3xx.bin";
	};
};

#include "nixge-1g-common.dtsi"
#include "n310-common.dtsi"
#include "dma-common.dtsi"

};
