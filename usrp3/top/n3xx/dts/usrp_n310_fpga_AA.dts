/*
 * Copyright (c) 2017 National Instruments Corp
 *
 * SPDX-License-Identifier: GPL-2.0 OR X11
 */

/dts-v1/;
/plugin/;

/{

fragment@0 {
	target = <&fpga_region0>;
	reg = <0x0000>;
	#address-cells = <1>;
	#size-cells = <1>;
	__overlay__ {
		#address-cells = <1>;
		#size-cells = <1>;
		firmware-name = "n3xx.bin";
	};
};

fragment@1 {
	target = <&amba>;
	reg = <0x0001>;
	__overlay__ {
		uio@40006000 {
			compatible = "usrp-uio";
			reg = <0x40004000 0x1000>;
			reg-names = "misc-auro-regs0";
			status = "okay";
		};


		uio@4000c000 {
			compatible = "usrp-uio";
			reg = <0x4000c000 0x1000>;
			reg-names = "misc-auro-regs1";
			status = "okay";
		};
	};
};

#include "n310-common.dtsi"
#include "dma-common.dtsi"

};

