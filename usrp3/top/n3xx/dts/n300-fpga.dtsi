/*
 * Copyright (c) 2017 National Instruments Corp
 *
 * SPDX-License-Identifier: GPL-2.0 OR X11
 */

fragment@0 {
	target = <&fpga_region0>;
	reg = <0x0000>;
	#address-cells = <1>;
	#size-cells = <1>;
	__overlay__ {
		#address-cells = <1>;
		#size-cells = <1>;
		firmware-name = "n300.bin";
	};
};
